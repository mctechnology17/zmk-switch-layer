## Kconfig
```kconfig
config ZMK_SWITCH_LAYER_BEHAVIOR
    bool
    default y
    depends on DT_HAS_ZMK_SWITCH_LAYER_BEHAVIOR_SWITCH_LAYER_MODE_ENABLED && SETTINGS

config ZMK_SWITCH_DEFAULT_LAYER_BEHAVIOR
    bool
    default y
    depends on DT_HAS_ZMK_SWITCH_LAYER_BEHAVIOR_SWITCH_DEFAULT_LAYER_MODE_ENABLED && SETTINGS
```

## dts/bindings/behaviors/zmk-switch-layer,behavior-switch-default-layer-mode.yaml
```yaml
# Copyright (c) 2026 Marcos Chow Castro
# SPDX-License-Identifier: MIT

description: Persistently switch the default layer between two configured layers

compatible: "zmk-switch-layer,behavior-switch-default-layer-mode"

include: one_param.yaml

properties:
  source-layer:
    type: int
    required: true
  target-layer:
    type: int
    required: true
```

## dts/bindings/behaviors/zmk-switch-layer,behavior-switch-layer-mode.yaml
```yaml
# Copyright (c) 2026 Marcos Chow Castro
# SPDX-License-Identifier: MIT

description: Persistently redirect one layer to another while the source layer is active

compatible: "zmk-switch-layer,behavior-switch-layer-mode"

include: one_param.yaml

properties:
  source-layer:
    type: int
    required: true
  target-layer:
    type: int
    required: true
```
